## CMakeLists.txt
```
# SPDX-License-Identifier: Apache-2.0

cmake_minimum_required(VERSION 3.20.0)

find_package(Zephyr REQUIRED HINTS $ENV{ZEPHYR_BASE})
project(hello-world)

target_sources(app PRIVATE src/main.c src/cloud_upload.c)
```

## prj.conf
```kconfig
CONFIG_USE_SEGGER_RTT=y
CONFIG_RTT_CONSOLE=y
CONFIG_UART_CONSOLE=n
CONFIG_LOG=y
CONFIG_LOG_BACKEND_RTT=y
CONFIG_SEGGER_RTT_BUFFER_SIZE_UP=4096

# Sensors
CONFIG_SENSOR=y
CONFIG_BME680=y
CONFIG_BH1749=y
CONFIG_I2C=y
CONFIG_CBPRINTF_FP_SUPPORT=y

# Modem / LTE
CONFIG_NRF_MODEM_LIB=y
CONFIG_LTE_LINK_CONTROL=y
CONFIG_NETWORKING=y
CONFIG_NET_NATIVE=n
CONFIG_NET_SOCKETS=y
CONFIG_NET_SOCKETS_OFFLOAD=y

# TLS for HTTPS (modem-native, no mbedTLS needed)
CONFIG_MODEM_KEY_MGMT=y

# DNS
CONFIG_DNS_RESOLVER=y

# Heap and stacks (larger for TLS handshake)
CONFIG_HEAP_MEM_POOL_SIZE=16384
CONFIG_MAIN_STACK_SIZE=8192
CONFIG_SYSTEM_WORKQUEUE_STACK_SIZE=4096

# Watchdog — auto-resets device if main loop hangs
CONFIG_WATCHDOG=y
CONFIG_WDT_NRFX=y
```

## src/main.c
```c
#include <zephyr/kernel.h>
#include <zephyr/device.h>
#include <zephyr/drivers/sensor.h>
#include <zephyr/drivers/watchdog.h>
#include <zephyr/logging/log.h>
#include <modem/lte_lc.h>
#include <modem/nrf_modem_lib.h>
#include <nrf_modem_at.h>

#include "cloud_upload.h"

LOG_MODULE_REGISTER(greenhouse, LOG_LEVEL_INF);

#define SAMPLE_INTERVAL_MS 5000
#define CLOUD_SEND_EVERY  12  /* Send to cloud every 12 samples (60s) */
#define LTE_RECONNECT_DELAY_MS 10000  /* Wait 10s before reconnect attempt */
#define LTE_RECONNECT_TIMEOUT_S 60  /* Must be well under WDT timeout */
#define LTE_MAX_RECONNECT_ATTEMPTS 3  /* Power cycle modem after this many failures */
#define WDT_TIMEOUT_MS 120000  /* 2 minutes — reset if stuck */

static const struct device *bme680;
static const struct device *bh1749;
static const struct device *wdt;
static int wdt_channel_id;
static volatile bool lte_connected;
static int upload_failures;
static int reconnect_failures;

K_SEM_DEFINE(lte_connected_sem, 0, 1);

static void lte_handler(const struct lte_lc_evt *const evt)
{
	switch (evt->type) {
	case LTE_LC_EVT_NW_REG_STATUS:
		if (evt->nw_reg_status == LTE_LC_NW_REG_REGISTERED_HOME) {
			LOG_INF("LTE: Connected (home)");
			lte_connected = true;
			k_sem_give(&lte_connected_sem);
		} else if (evt->nw_reg_status == LTE_LC_NW_REG_REGISTERED_ROAMING) {
			LOG_INF("LTE: Connected (roaming)");
			lte_connected = true;
			k_sem_give(&lte_connected_sem);
		} else if (evt->nw_reg_status == LTE_LC_NW_REG_SEARCHING) {
			LOG_INF("LTE: Searching...");
			lte_connected = false;
		} else if (evt->nw_reg_status == LTE_LC_NW_REG_NOT_REGISTERED) {
			LOG_WRN("LTE: Deregistered");
			lte_connected = false;
		}
		break;
	case LTE_LC_EVT_CELL_UPDATE:
		LOG_INF("LTE: Cell ID: %d, Tracking area: %d",
			evt->cell.id, evt->cell.tac);
		break;
	default:
		break;
	}
}

static void feed_watchdog(void)
{
	if (wdt_channel_id >= 0 && device_is_ready(wdt)) {
		wdt_feed(wdt, wdt_channel_id);
	}
}

static int lte_reconnect(void)
{
	int err;

	/* If we've failed too many times, power cycle the modem */
	if (reconnect_failures >= LTE_MAX_RECONNECT_ATTEMPTS) {
		LOG_WRN("LTE: %d consecutive failures, power cycling modem",
			reconnect_failures);
		lte_lc_power_off();
		k_msleep(2000);
		lte_lc_normal();
		reconnect_failures = 0;
	}

	LOG_INF("LTE: Attempting reconnect...");
	k_sem_reset(&lte_connected_sem);

	err = lte_lc_connect_async(lte_handler);
	if (err) {
		LOG_ERR("LTE reconnect request failed: %d", err);
		reconnect_failures++;
		return err;
	}

	/* Wait with timeout well under watchdog window */
	if (k_sem_take(&lte_connected_sem, K_SECONDS(LTE_RECONNECT_TIMEOUT_S)) != 0) {
		LOG_WRN("LTE: Reconnect timed out after %ds", LTE_RECONNECT_TIMEOUT_S);
		reconnect_failures++;
		return -ETIMEDOUT;
	}

	LOG_INF("LTE: Reconnected");
	reconnect_failures = 0;
	return 0;
}

static void read_sensors_csv(int sample)
{
	struct sensor_value temp, hum, press, gas;
	struct sensor_value r, g, b, ir;
	int temp_i = 0, temp_f = 0;
	int hum_i = 0, hum_f = 0;
	int press_i = 0, press_f = 0;
	int gas_val = 0, r_val = 0, g_val = 0, b_val = 0, ir_val = 0;

	if (device_is_ready(bme680)) {
		sensor_sample_fetch(bme680);
		sensor_channel_get(bme680, SENSOR_CHAN_AMBIENT_TEMP, &temp);
		sensor_channel_get(bme680, SENSOR_CHAN_HUMIDITY, &hum);
		sensor_channel_get(bme680, SENSOR_CHAN_PRESS, &press);
		sensor_channel_get(bme680, SENSOR_CHAN_GAS_RES, &gas);
		temp_i = temp.val1;
		temp_f = temp.val2 / 10000; /* 2 decimal places */
		hum_i = hum.val1;
		hum_f = hum.val2 / 10000;
		press_i = press.val1;
		press_f = press.val2 / 10000;
		gas_val = gas.val1;
	}

	if (device_is_ready(bh1749)) {
		sensor_sample_fetch(bh1749);
		sensor_channel_get(bh1749, SENSOR_CHAN_RED, &r);
		sensor_channel_get(bh1749, SENSOR_CHAN_GREEN, &g);
		sensor_channel_get(bh1749, SENSOR_CHAN_BLUE, &b);
		sensor_channel_get(bh1749, SENSOR_CHAN_IR, &ir);
		r_val = r.val1;
		g_val = g.val1;
		b_val = b.val1;
		ir_val = ir.val1;
	}

	/* Use uptime as timestamp (ms since boot) */
	int64_t ts = k_uptime_get();

	printk("%lld,%d,%d.%02d,%d.%02d,%d.%02d,%d,%d,%d,%d,%d\n",
	       ts, sample, temp_i, temp_f, hum_i, hum_f, press_i, press_f,
	       gas_val, r_val, g_val, b_val, ir_val);

	/* Send to Google Sheets every CLOUD_SEND_EVERY samples */
	if (sample % CLOUD_SEND_EVERY == 0) {
		/* Feed watchdog before potentially long cloud operations */
		feed_watchdog();

		if (!lte_connected) {
			LOG_WRN("LTE not connected, attempting reconnect");
			lte_reconnect();
		}

		/* Feed again after reconnect attempt, before TLS/HTTP */
		feed_watchdog();

		if (lte_connected) {
			int battery = cloud_read_battery();
			int rsrp = cloud_read_rsrp();
			int uptime_s = (int)(k_uptime_get() / 1000);
			int ret = cloud_send_sensor_data(temp_i, temp_f, hum_i, hum_f,
					       press_i, press_f, gas_val,
					       r_val, g_val, b_val, ir_val,
					       battery, rsrp,
					       uptime_s, upload_failures);
			if (ret < 0) {
				LOG_WRN("Cloud upload failed (%d), will retry next cycle", ret);
				lte_connected = false;
				upload_failures++;
			} else {
				upload_failures = 0;
			}
		} else {
			upload_failures++;
		}
	}
}

int main(void)
{
	int err;
	int sample = 0;

	printk("=== Greenhouse Sensor Hub ===\n\n");

	/* Initialize modem */
	printk("Initializing modem...\n");
	err = nrf_modem_lib_init();
	if (err) {
		printk("Modem init failed: %d\n", err);
		return -1;
	}

	/* Provision TLS cert for Google Sheets */
	cloud_provision_cert();

	/* Query modem firmware version */
	char response[64];
	err = nrf_modem_at_cmd(response, sizeof(response), "AT+CGMR");
	if (!err) {
		printk("Modem FW: %s", response);
	}

	/* Connect to LTE */
	printk("Connecting to LTE (this may take 30-60s)...\n");
	err = lte_lc_connect_async(lte_handler);
	if (err) {
		printk("LTE connect failed: %d\n", err);
		return -1;
	}

	/* Wait for network registration (up to 120s) */
	if (k_sem_take(&lte_connected_sem, K_SECONDS(120)) != 0) {
		printk("LTE: Initial connection timed out, continuing anyway...\n");
	} else {
		lte_connected = true;
		printk("LTE connected!\n\n");
	}

	/* Initialize sensors */
	bme680 = DEVICE_DT_GET_ANY(bosch_bme680);
	bh1749 = DEVICE_DT_GET_ANY(rohm_bh1749);

	printk("Sensors:\n");
	printk("  BME680 (env):   %s\n", device_is_ready(bme680) ? "ready" : "NOT FOUND");
	printk("  BH1749 (light): %s\n", device_is_ready(bh1749) ? "ready" : "NOT FOUND");
	printk("\n");

	/* Initialize hardware watchdog — resets device if main loop stalls */
	wdt = DEVICE_DT_GET(DT_NODELABEL(wdt0));
	if (device_is_ready(wdt)) {
		struct wdt_timeout_cfg wdt_cfg = {
			.window.min = 0,
			.window.max = WDT_TIMEOUT_MS,
			.callback = NULL, /* System reset on timeout */
			.flags = WDT_FLAG_RESET_SOC,
		};
		wdt_channel_id = wdt_install_timeout(wdt, &wdt_cfg);
		if (wdt_channel_id >= 0) {
			wdt_setup(wdt, WDT_OPT_PAUSE_HALTED_BY_DBG);
			LOG_INF("Watchdog started (%d s timeout)", WDT_TIMEOUT_MS / 1000);
		} else {
			LOG_WRN("Watchdog install failed: %d", wdt_channel_id);
		}
	} else {
		LOG_WRN("Watchdog device not ready");
	}

	/* Main sensor loop — CSV output */
	printk("uptime_ms,sample,temp_c,humidity_pct,pressure_kpa,gas_ohm,red,green,blue,ir\n");
	while (1) {
		feed_watchdog();
		sample++;
		read_sensors_csv(sample);
		k_msleep(SAMPLE_INTERVAL_MS);
	}

	return 0;
}
```

## src/cloud_upload.c
```c
#include <zephyr/kernel.h>
#include <zephyr/net/socket.h>
#include <zephyr/net/tls_credentials.h>
#include <zephyr/logging/log.h>
#include <modem/modem_key_mgmt.h>
#include <nrf_modem_at.h>
#include <string.h>

#include "cloud_upload.h"

LOG_MODULE_REGISTER(cloud, LOG_LEVEL_INF);

#define TLS_SEC_TAG 42
#define HTTPS_PORT 443
#define HOST "script.google.com"
#define PATH "/macros/s/AKfycbzSCfVOhfDwxb2ymJmoYF-PILGAPOAikMPT1LcVcRXTBFt_Jtv_-9pq1AXAeAg57uWy/exec"

/* Google GTS Root R1 CA certificate (used by script.google.com) */
static const char ca_cert[] =
	"-----BEGIN CERTIFICATE-----\n"
	"MIIFVzCCAz+gAwIBAgINAgPlk28xsBNJiGuiFzANBgkqhkiG9w0BAQwFADBHMQsw\n"
	"CQYDVQQGEwJVUzEiMCAGA1UEChMZR29vZ2xlIFRydXN0IFNlcnZpY2VzIExMQzEU\n"
	"MBIGA1UEAxMLR1RTIFJvb3QgUjEwHhcNMTYwNjIyMDAwMDAwWhcNMzYwNjIyMDAw\n"
	"MDAwWjBHMQswCQYDVQQGEwJVUzEiMCAGA1UEChMZR29vZ2xlIFRydXN0IFNlcnZp\n"
	"Y2VzIExMQzEUMBIGA1UEAxMLR1RTIFJvb3QgUjEwggIiMA0GCSqGSIb3DQEBAQUA\n"
	"A4ICDwAwggIKAoICAQC2EQKLHuOhd5s73L+UPreVp0A8of2C+X0yBoJx9vaMf/vo\n"
	"27xqLpeXo4xL+Sv2sfnOhB2x+cWX3u+58qPpvBKJXqeqUqv4IyfLpLGcY9vXmX7w\n"
	"Cl7raKb0xlpHDU0QM+NOsROjyBhsS+z8CZDfnWQpJSMHobTSPS5g4M/SCYe7zUjw\n"
	"TcLCeoiKu7rPWRnWr4+wB7CeMfGCwcDfLqZtbBkOtdh+JhpFAz2weaSUKK0Pfybl\n"
	"qAj+lug8aJRT7oM6iCsVlgmy4HqMLnXWnOunVmSPlk9orj2XwoSPwLxAwAtcvfaH\n"
	"szVsrBhQf4TgTM2S0yDpM7xSma8ytSmzJSq0SPly4cpk9+aCEI3oncKKiPo4Zor8\n"
	"Y/kB+Xj9e1x3+naH+uzfsQ55lVe0vSbv1gHR6xYKu44LtcXFilWr06zqkUspzBmk\n"
	"MiVOKvFlRNACzqrOSbTqn3yDsEB750Orp2yjj32JgfpMpf/VjsPOS+C12LOORc92\n"
	"wO1AK/1TD7Cn1TsNsYqiA94xrcx36m97PtbfkSIS5r762DL8EGMUUXLeXdYWk70p\n"
	"aDPvOmbsB4om3xPXV2V4J95eSRQAogB/mqghtqmxlbCluQ0WEdrHbEg8QOB+DVrN\n"
	"VjzRlwW5y0vtOUucxD/SVRNuJLDWcfr0wbrM7Rv1/oFB2ACYPTrIrnqYNxgFlQID\n"
	"AQABo0IwQDAOBgNVHQ8BAf8EBAMCAYYwDwYDVR0TAQH/BAUwAwEB/zAdBgNVHQ4E\n"
	"FgQU5K8rJnEaK0gnhS9SZizv8IkTcT4wDQYJKoZIhvcNAQEMBQADggIBAJ+qQibb\n"
	"C5u+/x6Wki4+omVKapi6Ist9wTrYggoGxval3sBOh2Z5ofmmWJyq+bXmYOfg6LEe\n"
	"QkEzCzc9zolwFcq1JKjPa7XSQCGYzyI0zzvFIoTgxQ6KfF2I5DUkzps+GlQebtuy\n"
	"h6f88/qBVRRiClmpIgUxPoLW7ttXNLwzldMXG+gnoot7TiYaelpkttGsN/H9oPM4\n"
	"7HLwEXWdyzRSjeZ2axfG34arJ45JK3VmgRAhpuo+9K4l/3wV3s6MJT/KYnAK9y8J\n"
	"ZgfIPxz88NtFMN9iiMG1D53Dn0reWVlHxYciNuaCp+0KueIHoI17eko8cdLiA6Ef\n"
	"MgfdG+RCzgwARWGAtQsgWSl4vflVy2PFPEz0tv/bal8xa5meLMFrUKTX5hgUvYU/\n"
	"Z6tGn6D/Qqc6f1zLXbBwHSs09dR2CQzreExZBfMzQsNhFRAbd03OIozUhfJFfbdT\n"
	"6u9AWpQKXCBfTkBdYiJ23//OYb2MI3jSNwLgjt7RETeJ9r/tSQdirpLsQBqvFAnZ\n"
	"0E6yove+7u7Y/9waLd64NnHi/Hm3lCXRSHNboTXns5lndcEZOitHTtNCjv0xyBZm\n"
	"2tIMPNuzjsmhDYAPexZ3FL//2wmUspO8IFgV6dtxQ/PeEMMA3KgqlbbC1j+Qa3bb\n"
	"bP6MvPJwNQzcmRk13NfIRmPVNnGuV/u3gm3c\n"
	"-----END CERTIFICATE-----\n";

int cloud_provision_cert(void)
{
	int err;

	/* Always overwrite to ensure correct cert */
	err = modem_key_mgmt_write(TLS_SEC_TAG,
				   MODEM_KEY_MGMT_CRED_TYPE_CA_CHAIN,
				   ca_cert, sizeof(ca_cert) - 1);
	if (err) {
		LOG_ERR("Failed to provision cert: %d", err);
		return err;
	}

	LOG_INF("TLS cert provisioned (tag %d)", TLS_SEC_TAG);
	return 0;
}

int cloud_read_battery(void)
{
	char buf[64];
	uint16_t vbat_mv = 0;
	int err;

	err = nrf_modem_at_cmd(buf, sizeof(buf), "AT%%XVBAT");
	if (err) {
		LOG_WRN("AT%%XVBAT cmd failed: %d", err);
		return -1;
	}

	/* Response format: "%XVBAT: <millivolts>\r\n" */
	if (sscanf(buf, "%%XVBAT: %hu", &vbat_mv) != 1) {
		LOG_WRN("AT%%XVBAT parse failed, raw: %.40s", buf);
		return -1;
	}

	int percent = (vbat_mv - 3000) * 100 / 1200;
	if (percent > 100) percent = 100;
	if (percent < 0) percent = 0;

	LOG_INF("Battery: %u mV (%d%%)", vbat_mv, percent);
	return percent;
}

int cloud_read_rsrp(void)
{
	char buf[128];
	int err;

	err = nrf_modem_at_cmd(buf, sizeof(buf), "AT+CESQ");
	if (err) {
		LOG_WRN("AT+CESQ cmd failed: %d", err);
		return -999;
	}

	/* Response: "+CESQ: <rxlev>,<ber>,<rscp>,<ecno>,<rsrq>,<rsrp>" */
	int rxlev, ber, rscp, ecno, rsrq, rsrp;
	if (sscanf(buf, "+CESQ: %d,%d,%d,%d,%d,%d",
		   &rxlev, &ber, &rscp, &ecno, &rsrq, &rsrp) < 6) {
		LOG_WRN("AT+CESQ parse failed, raw: %.60s", buf);
		return -999;
	}

	/* RSRP index 0-97 maps to -140..-44 dBm (index 255 = not known) */
	if (rsrp == 255) {
		LOG_WRN("RSRP not available");
		return -999;
	}

	int rsrp_dbm = rsrp - 140;
	LOG_INF("RSRP: %d dBm", rsrp_dbm);
	return rsrp_dbm;
}

int cloud_send_sensor_data(int temp_i, int temp_f,
			   int hum_i, int hum_f,
			   int press_i, int press_f,
			   int gas, int r, int g, int b, int ir_val,
			   int battery_pct, int rsrp,
			   int uptime_s, int failures)
{
	int fd;
	int err;
	char payload[256];
	char request[640];
	char response[256];

	/* Format JSON payload */
	int plen = snprintf(payload, sizeof(payload),
		"{\"temp\":%d.%02d,\"hum\":%d.%02d,\"press\":%d.%02d,"
		"\"gas\":%d,\"r\":%d,\"g\":%d,\"b\":%d,\"ir\":%d,"
		"\"battery\":%d,\"rsrp\":%d,\"uptime\":%d,\"failures\":%d}",
		temp_i, temp_f, hum_i, hum_f, press_i, press_f,
		gas, r, g, b, ir_val, battery_pct, rsrp,
		uptime_s, failures);

	/* Create TLS socket */
	fd = socket(AF_INET, SOCK_STREAM, IPPROTO_TLS_1_2);
	if (fd < 0) {
		LOG_ERR("Socket create failed: %d", errno);
		return -errno;
	}

	/* Set socket timeouts BEFORE connect — on nRF9160 modem, SO_RCVTIMEO
	 * also applies to the TLS handshake in connect(). This prevents
	 * indefinite blocking if the server is unreachable. */
	struct timeval timeout = { .tv_sec = 30, .tv_usec = 0 };
	setsockopt(fd, SOL_SOCKET, SO_RCVTIMEO, &timeout, sizeof(timeout));
	setsockopt(fd, SOL_SOCKET, SO_SNDTIMEO, &timeout, sizeof(timeout));

	/* Set TLS options */
	sec_tag_t sec_tag_list[] = { TLS_SEC_TAG };
	err = setsockopt(fd, SOL_TLS, TLS_SEC_TAG_LIST,
			 sec_tag_list, sizeof(sec_tag_list));
	if (err) {
		LOG_ERR("TLS sec tag failed: %d", errno);
		close(fd);
		return -errno;
	}

	err = setsockopt(fd, SOL_TLS, TLS_HOSTNAME, HOST, strlen(HOST));
	if (err) {
		LOG_ERR("TLS hostname failed: %d", errno);
		close(fd);
		return -errno;
	}

	/* Resolve and connect */
	struct addrinfo hints = {
		.ai_family = AF_INET,
		.ai_socktype = SOCK_STREAM,
	};
	struct addrinfo *addr;

	err = getaddrinfo(HOST, "443", &hints, &addr);
	if (err) {
		LOG_ERR("DNS resolve failed: %d", err);
		close(fd);
		return -1;
	}

	err = connect(fd, addr->ai_addr, addr->ai_addrlen);
	freeaddrinfo(addr);
	if (err) {
		LOG_ERR("Connect failed: %d", errno);
		close(fd);
		return -errno;
	}

	/* Build HTTP POST request */
	int rlen = snprintf(request, sizeof(request),
		"POST %s HTTP/1.1\r\n"
		"Host: %s\r\n"
		"Content-Type: application/json\r\n"
		"Content-Length: %d\r\n"
		"Connection: close\r\n"
		"\r\n"
		"%s",
		PATH, HOST, plen, payload);

	/* Send */
	err = send(fd, request, rlen, 0);
	if (err < 0) {
		LOG_ERR("Send failed: %d", errno);
		close(fd);
		return -errno;
	}

	/* Read response (just check status) */
	int bytes = recv(fd, response, sizeof(response) - 1, 0);
	if (bytes > 0) {
		response[bytes] = '\0';
		/* Check for 200 OK or 302 redirect (both mean success for Apps Script) */
		if (strstr(response, "200") || strstr(response, "302")) {
			LOG_INF("Cloud upload OK");
		} else {
			LOG_WRN("Cloud response: %.40s", response);
		}
	}

	close(fd);
	return 0;
}
```

## src/cloud_upload.h
```c
#ifndef CLOUD_UPLOAD_H
#define CLOUD_UPLOAD_H

/**
 * Provision the TLS certificate for Google into the modem.
 * Call once after modem init, before LTE connect.
 */
int cloud_provision_cert(void);

/**
 * Read battery voltage and return percentage (0-100).
 * Returns -1 on failure (e.g., modem FW too old).
 */
int cloud_read_battery(void);

/**
 * Read LTE signal strength (RSRP) in dBm.
 * Returns -999 on failure.
 */
int cloud_read_rsrp(void);

/**
 * Send sensor data to Google Sheets via Apps Script webhook.
 * Returns 0 on success, negative on error.
 */
int cloud_send_sensor_data(int temp_i, int temp_f,
			   int hum_i, int hum_f,
			   int press_i, int press_f,
			   int gas, int r, int g, int b, int ir_val,
			   int battery_pct, int rsrp,
			   int uptime_s, int failures);

#endif /* CLOUD_UPLOAD_H */
```
